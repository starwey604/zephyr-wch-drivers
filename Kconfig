## Kconfig
```kconfig
# SPDX-License-Identifier: Apache-2.0

menuconfig WCH_DRIVERS
	bool "Out-of-tree WCH drivers"
	depends on SOC_CH32V203
	help
	  Enable the external WCH driver module. Initial development targets
	  CH32V203, with CH32V203F8U6 as the first hardware validation target.
	  Individual peripheral drivers must be enabled separately.
	  Enabling this option alone does not replace upstream drivers.

if WCH_DRIVERS
rsource "drivers/Kconfig"
endif
```

## drivers/Kconfig
```kconfig
# SPDX-License-Identifier: Apache-2.0

rsource "serial/Kconfig"
rsource "dma/Kconfig"
rsource "usb/Kconfig"
```

## drivers/dma/Kconfig
```kconfig
# SPDX-License-Identifier: Apache-2.0

config WCH_DMA
	bool "Out-of-tree CH32V203 DMA driver"
	depends on DMA && DT_HAS_WCH_WCH_DMA_ENABLED
	help
	  Opt-in replacement for DMA_WCH. Supports fixed channel allocation,
	  single blocks and peripheral circular transfers. Disable DMA_WCH
	  explicitly; both drivers instantiate the same devicetree devices.
```

## drivers/serial/Kconfig
```kconfig
# SPDX-License-Identifier: Apache-2.0

config WCH_UART
	bool "External WCH USART polling/interrupt baseline"
	depends on SERIAL
	depends on DT_HAS_WCH_USART_ENABLED
	select SERIAL_HAS_DRIVER
	select SERIAL_SUPPORT_INTERRUPT
	select SERIAL_SUPPORT_ASYNC
	select PINCTRL
	help
	  Opt-in downstream copy of the community WCH USART driver, for
	  CH32V203 bring-up. Disable UART_WCH_USART explicitly to avoid two
	  drivers owning the same devicetree nodes. Polling and interrupt
	  APIs are present; experimental async TX is a separate opt-in option.
	  UART1 paced polling has been tested on one CH32V203F8U board.
	  Bounded dual IRQ echo passed at 115200; 921600 is not qualified.
	  Asynchronous modes still require hardware validation.

config WCH_UART_IRQ_TRACE
	bool "CH32V203 UART IRQ RAM flight recorder (diagnostic only)"
	depends on WCH_UART && UART_INTERRUPT_DRIVEN && !UART_ASYNC_API
	depends on SOC_CH32V203 && CH32V00X_SYSTICK && !SMP
	help
	  Record IRQ timing, existing status reads, and byte counts in RAM.
	  No printk, UART output, allocation or additional STATR/DATAR reads.
	  Timing is perturbed by instrumentation. Decode only after traffic;
	  the first observed hardware error freezes the event ring, not counters.

config WCH_UART_IRQ_TRACE_SLOW_US
	int "IRQ callback slow threshold in nominal microseconds"
	depends on WCH_UART_IRQ_TRACE
	range 1 1000
	default 8

config WCH_UART_IRQ_TRACE_SAMPLE_INTERVAL
	int "Time one in N IRQ callbacks (1 = intrusive full timing)"
	depends on WCH_UART_IRQ_TRACE
	range 1 65535
	default 127
	help
	  Error snapshots and byte counters remain enabled on every IRQ.
	  Full timing caused extra overruns during dual 921600 bring-up;
	  sampled timing reduces but does not eliminate observer overhead.
	  Prefer an odd interval to avoid always sampling TX in alternating
	  RX/TX interrupt traffic.

config WCH_UART_DMA_PREPARE
	bool "Validate CH32V203 USART1/2 DMA resources (no transfers yet)"
	depends on WCH_UART && DMA
	help
	  Check tx/rx devicetree mappings and DMA controller readiness before
	  UART initialization. This does not reserve/start DMA channels or
	  select SERIAL_SUPPORT_ASYNC. It prepares the next development stage.

config WCH_UART_ASYNC_TX
	bool "Experimental CH32V203 asynchronous DMA TX"
	depends on WCH_UART && UART_ASYNC_API && DMA && WCH_DMA
	select WCH_UART_DMA_PREPARE
	help
	  Reserve USART1/2 TX and RX DMA channels and implement byte-wide TX,
	  abort and a software deadline. TX_DONE waits for USART TC. Async RX
	  requires the separate WCH_UART_ASYNC_RX option. Disable
	  UART_INTERRUPT_DRIVEN and UART_WIDE_DATA:
	  mixed IRQ/async and wide data are not supported in this increment.
	  Not yet hardware-qualified. Do not use for production control buses.

config WCH_UART_ASYNC_RX
	bool "Experimental CH32V203 asynchronous DMA RX (no inactivity timeout)"
	depends on WCH_UART_ASYNC_TX
	help
	  Enable byte-wide RX with one current and one queued buffer, explicit
	  disable and UART/DMA error events. Only SYS_FOREVER_US is accepted;
	  finite inactivity timeout and IDLE handling await hardware validation.
	  Normal-mode DMA rearming has a gap: lossless continuous reception,
	  especially dual 3 Mbaud operation, is NOT yet qualified.
```

## drivers/usb/Kconfig
```kconfig
# SPDX-License-Identifier: Apache-2.0
config WCH_UDC
	bool "Experimental CH32V203 USBFS device controller"
	depends on DT_HAS_WCH_CH32V203_USBFS_ENABLED && UDC_DRIVER
	depends on !UDC_ENABLE_SOF
	select UDC_WORKQUEUE
	help
	  Full Speed EP0 plus EP1 IN and EP2 OUT bulk endpoints, using internal
	  endpoint DMA staging buffers. No general DMA1 dependency. Not hardware
	  qualified. No isochronous, remote wakeup or power management support.

config WCH_UDC_RELEASE_SDI
	bool "Allow USBFS to release shared SDI debug pins"
	depends on WCH_UDC
	help
	  Explicit opt-in for packages such as Gello QFN20. Initializing USB
	  disconnects SDI debugging. Keep NRST accessible and disconnect the
	  probe from the USB pair before connecting a host. Reset restores SDI.
```

## dts/bindings/usb/wch,ch32v203-usbfs.yaml
```yaml
# SPDX-License-Identifier: Apache-2.0
description: |
  Experimental downstream CH32V203 USBFS (USBHD) controller at 0x50000000.
  Exposes EP0 control, EP1 bulk IN and EP2 bulk OUT only. Endpoint staging
  DMA is internal to USBFS; do not add DMA1 dmas properties.
compatible: "wch,ch32v203-usbfs"
include: [usb-controller.yaml]
properties:
  reg:
    required: true
  interrupts:
    required: true
  clocks:
    required: true
  maximum-speed:
    const: "full-speed"
  wch,pll-frequency:
    type: int
    required: true
    enum: [48000000, 96000000, 144000000]
    description: PLL frequency in Hz; the driver programs the USB 48 MHz divider.
  wch,disable-sdi:
    type: boolean
    description: USB pads share SDI on this package; requires WCH_UDC_RELEASE_SDI.
```

## tests/drivers/uart_irq/testcase.yaml
```yaml
# SPDX-License-Identifier: Apache-2.0
tests:
  wch.uart_irq.hil:
    tags: [uart, wch]
    platform_allow: [ragtime_gello/ch32v203]
    build_only: true
  wch.uart_irq.trace:
    tags: [uart, wch]
    platform_allow: [ragtime_gello/ch32v203]
    build_only: true
    extra_configs:
      - CONFIG_WCH_UART_IRQ_TRACE=y
```

## tests/drivers/uart_polling/testcase.yaml
```yaml
# SPDX-License-Identifier: Apache-2.0
tests:
  wch.uart_polling.hil:
    tags: [uart, wch]
    platform_allow: [ragtime_gello/ch32v203]
    build_only: true
```

## tests/drivers/uart_rx_host/testcase.yaml
```yaml
# SPDX-License-Identifier: Apache-2.0
tests:
  wch.uart_rx_host.hil:
    tags: [uart, dma, wch]
    platform_allow: [ragtime_gello/ch32v203]
    build_only: true
```

## tests/unit/dma_native/testcase.yaml
```yaml
# SPDX-License-Identifier: Apache-2.0
tests:
  wch.dma.native:
    tags: [dma, wch]
    platform_allow: [native_sim/native/64]
    integration_platforms: [native_sim/native/64]
    harness: ztest
```

## tests/unit/uart_tx_native/testcase.yaml
```yaml
# SPDX-License-Identifier: Apache-2.0
tests:
  wch.uart_rx.native:
    tags: [uart, dma, wch]
    platform_allow: [native_sim/native/64]
    integration_platforms: [native_sim/native/64]
    harness: ztest
    extra_args: WCH_TEST_RX=ON
  wch.uart_tx.native:
    tags: [uart, dma, wch]
    platform_allow: [native_sim/native/64]
    integration_platforms: [native_sim/native/64]
    harness: ztest
```

## tests/unit/udc_native/testcase.yaml
```yaml
# SPDX-License-Identifier: Apache-2.0
tests:
  wch.udc.native:
    platform_allow: [native_sim/native/64]
    integration_platforms: [native_sim/native/64]
    tags: [usb, wch]
    harness: ztest
```
